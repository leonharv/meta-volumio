## conf/layer.conf
```bitbake
# We have a conf and classes directory, add to BBPATH
BBPATH .= ":${LAYERDIR}"

# We have recipes-* directories, add to BBFILES
BBFILES += "${LAYERDIR}/recipes-*/*/*.bb \
	    ${LAYERDIR}/recipes-*/*/*.bbappend"

BBFILE_COLLECTIONS += "volumio"
BBFILE_PATTERN_volumio = "^${LAYERDIR}/"
BBFILE_PRIORITY_volumio = "6"
LAYERDEPENDS_volumio = "core"
```
